## yocto/meta-custom-bitstream/conf/layer.conf
```bitbake
# Layer configuration for a generic custom-bitstream/device-tree layer
# This layer can be reused for any project needing to inject build
# artifacts (bitstream/.dtb) generated by an external flow.

# See https://docs.yoctoproject.org for general information.

LCONF_VERSION = "7"

# Short description shown by bitbake-layers
LAYERSERIES_COMPAT_meta-custom = "hardknott kirkstone langdale master"

BBPATH .= ":${LAYERDIR}"
BBFILES += "${LAYERDIR}/recipes-*/*/*.bb ${LAYERDIR}/recipes-*/*/*.bbappend"
```
